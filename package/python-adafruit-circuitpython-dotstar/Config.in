## package/python-adafruit-circuitpython-dotstar/Config.in
```kconfig
config BR2_PACKAGE_PYTHON_ADAFRUIT_CIRCUITPYTHON_DOTSTAR
	bool "python-adafruit-circuitpython-dotstar"
	select BR2_PACKAGE_PYTHON_ADAFRUIT_CIRCUITPYTHON_PIXELBUF # runtime
	select BR2_PACKAGE_PYTHON_ADAFRUIT_CIRCUITPYTHON_TYPING # runtime
	help
	  CircuitPython library for DotStar LEDs.

	  https://github.com/adafruit/Adafruit_CircuitPython_DotStar
```

## package/python-adafruit-circuitpython-hid/Config.in
```kconfig
config BR2_PACKAGE_PYTHON_ADAFRUIT_CIRCUITPYTHON_HID
	bool "python-adafruit-circuitpython-hid"
	select BR2_PACKAGE_PYTHON_ADAFRUIT_BLINKA # runtime
	help
	  CircuitPython helper library for simulating HID devices.

	  https://github.com/adafruit/Adafruit_CircuitPython_HID
```

## package/python-adafruit-circuitpython-led-animation/Config.in
```kconfig
config BR2_PACKAGE_PYTHON_ADAFRUIT_CIRCUITPYTHON_LED_ANIMATION
	bool "python-adafruit-circuitpython-led-animation"
	select BR2_PACKAGE_PYTHON_ADAFRUIT_BLINKA # runtime
	help
	  CircuitPython helper for LED colors and animations.

	  https://github.com/adafruit/Adafruit_CircuitPython_LED_Animation
```

## package/python-adafruit-circuitpython-neokey/Config.in
```kconfig
config BR2_PACKAGE_PYTHON_ADAFRUIT_CIRCUITPYTHON_NEOKEY
	bool "python-adafruit-circuitpython-neokey"
        select BR2_PACKAGE_PYTHON_ADAFRUIT_CIRCUITPYTHON_SEESAW # runtime
	help
	  CircuitPython library for using Adafruit NeoKey.

	  https://github.com/adafruit/Adafruit_CircuitPython_NeoKey
```

## package/python-adafruit-circuitpython-neopixel/Config.in
```kconfig
config BR2_PACKAGE_PYTHON_ADAFRUIT_CIRCUITPYTHON_NEOPIXEL
	bool "python-adafruit-circuitpython-neopixel"
	select BR2_PACKAGE_PYTHON_ADAFRUIT_CIRCUITPYTHON_PIXELBUF # runtime
	help
	  CircuitPython library for NeoPixel LEDs.

	  https://github.com/adafruit/Adafruit_CircuitPython_NeoPixel
```

## package/python-adafruit-circuitpython-seesaw/Config.in
```kconfig
config BR2_PACKAGE_PYTHON_ADAFRUIT_CIRCUITPYTHON_SEESAW
	bool "python-adafruit-circuitpython-seesaw"
	select BR2_PACKAGE_PYTHON_ADAFRUIT_BLINKA # runtime
	select BR2_PACKAGE_PYTHON_ADAFRUIT_CIRCUITPYTHON_BUSDEVICE # runtime
	help
	  CircuitPython library for controlling a SeeSaw helper chip.

	  https://github.com/adafruit/Adafruit_CircuitPython_seesaw
```

## package/python-adafruit-circuitpython-ticks/Config.in
```kconfig
config BR2_PACKAGE_PYTHON_ADAFRUIT_CIRCUITPYTHON_TICKS
	bool "python-adafruit-circuitpython-ticks"
	select BR2_PACKAGE_PYTHON_ADAFRUIT_BLINKA # runtime
	help
	  Work with intervals and deadlines in milliseconds.

	  https://github.com/adafruit/Adafruit_CircuitPython_ticks.git
```
